## config/boards/shields/cornesqe/Kconfig.defconfig
```kconfig
# Copyright (c) 2020 The ZMK Contributors
# SPDX-License-Identifier: MIT

if SHIELD_CORNESQUE_DONGLE

config ZMK_KEYBOARD_NAME
	default "Cornesque Dongle"
	
config ZMK_SPLIT_BLE_ROLE_CENTRAL
	default y
	
config ZMK_USB
	default y

endif

if SHIELD_CORNESQUE_LEFT || SHIELD_CORNESQUE_RIGHT || SHIELD_CORNESQUE_DONGLE 

config ZMK_SPLIT
	default y

config ZMK_BLE
	default y
	
endif
```

## config/boards/shields/cornesque/Kconfig.shield
```kconfig
# Copyright (c) 2020 The ZMK Contributors
# SPDX-License-Identifier: MIT

config SHIELD_CORNESQUE_LEFT
	def_bool $(shields_list_contains,cornesque_left)

config SHIELD_CORNESQUE_RIGHT
	def_bool $(shields_list_contains,cornesque_right)

config SHIELD_CORNESQUE_DONGLE
	def_bool $(shields_list_contains,cornesque_dongle)
```
